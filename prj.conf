## CMakeLists.txt
```
# SPDX-License-Identifier: Apache-2.0

cmake_minimum_required(VERSION 3.20.0)

set(CMAKE_EXPORT_COMPILE_COMMANDS ON)

find_package(Zephyr REQUIRED HINTS $ENV{ZEPHYR_BASE})
project(ble_sensor)

target_sources(app PRIVATE 
                    src/main.c
                    src/imu_driver.c
                    # BLE drivers
                    src/ble/bluetoothle.c
                    src/ble/ble_gatt.c
)

zephyr_library_include_directories(src/ble)
```

## prj.conf
```kconfig
# Enable compiler output color
CONFIG_COMPILER_COLOR_DIAGNOSTICS=y

# Debug configs
CONFIG_ASSERT=y
CONFIG_RESET_ON_FATAL_ERROR=n

CONFIG_DEBUG=y
CONFIG_DEBUG_OPTIMIZATIONS=y
CONFIG_DEBUG_THREAD_INFO=y
CONFIG_DEBUG_COREDUMP=y
CONFIG_DEBUG_COREDUMP_BACKEND_LOGGING=y
CONFIG_CBPRINTF_FP_SUPPORT=y
CONFIG_THREAD_NAME=y
CONFIG_THREAD_ANALYZER=y


CONFIG_TRACING=y
CONFIG_TRACING_BACKEND_RAM=y

CONFIG_SEGGER_SYSTEMVIEW=y
CONFIG_USE_SEGGER_RTT=y

# Logger configs
CONFIG_LOG=y
CONFIG_LOG_BACKEND_RTT=n
CONFIG_LOG_BACKEND_UART=y
CONFIG_LOG_BACKEND_SHOW_COLOR=y
CONFIG_LOG_BACKEND_FORMAT_TIMESTAMP=y

# Bluetooth configs 
CONFIG_BT=y
CONFIG_BT_MAX_CONN=7
CONFIG_BT_LL_SW_SPLIT=y
CONFIG_BT_PERIPHERAL=y
CONFIG_BT_DEVICE_NAME="IMU"
CONFIG_BT_GATT_CLIENT=y
CONFIG_BT_USER_PHY_UPDATE=y
CONFIG_BT_USER_DATA_LEN_UPDATE=y
#This is the maximum data length with Nordic Softdevice controller
CONFIG_BT_CTLR_DATA_LENGTH_MAX=251
CONFIG_BT_GAP_AUTO_UPDATE_CONN_PARAMS=y
CONFIG_BT_PERIPHERAL_PREF_MIN_INT=10
CONFIG_BT_PERIPHERAL_PREF_MAX_INT=10
CONFIG_BT_PERIPHERAL_PREF_LATENCY=5
CONFIG_BT_PERIPHERAL_PREF_TIMEOUT=100
#These buffers are needed for the data length max. 
CONFIG_BT_BUF_ACL_TX_SIZE=251
CONFIG_BT_BUF_ACL_RX_SIZE=251
#This is the maximum MTU size with Nordic Softdevice controller
CONFIG_BT_L2CAP_TX_MTU=247

# IMU settings
CONFIG_SENSOR=y
CONFIG_LSM6DSL_TRIGGER_NONE=y
CONFIG_LSM6DSL_GYRO_FS=500
CONFIG_LSM6DSL_GYRO_ODR=4
CONFIG_LSM6DSL_ACCEL_ODR=4
CONFIG_LSM6DSL_ACCEL_FS=4
CONFIG_LSM6DSL_ENABLE_TEMP=y
```

## prj_release.conf
```kconfig
# Enable compiler output color
CONFIG_COMPILER_COLOR_DIAGNOSTICS=y

# Debug configs
CONFIG_ASSERT=n
CONFIG_RESET_ON_FATAL_ERROR=y

CONFIG_LOG=n

# Bluetooth configs 
CONFIG_BT=y
CONFIG_BT_MAX_CONN=7
CONFIG_BT_LL_SW_SPLIT=y
CONFIG_BT_PERIPHERAL=y
CONFIG_BT_DEVICE_NAME="IMU"
CONFIG_BT_GATT_CLIENT=y
CONFIG_BT_USER_PHY_UPDATE=y
CONFIG_BT_USER_DATA_LEN_UPDATE=y
#This is the maximum data length with Nordic Softdevice controller
CONFIG_BT_CTLR_DATA_LENGTH_MAX=251
CONFIG_BT_GAP_AUTO_UPDATE_CONN_PARAMS=y
CONFIG_BT_PERIPHERAL_PREF_MIN_INT=10
CONFIG_BT_PERIPHERAL_PREF_MAX_INT=10
CONFIG_BT_PERIPHERAL_PREF_LATENCY=5
CONFIG_BT_PERIPHERAL_PREF_TIMEOUT=100
#These buffers are needed for the data length max. 
CONFIG_BT_BUF_ACL_TX_SIZE=251
CONFIG_BT_BUF_ACL_RX_SIZE=251
#This is the maximum MTU size with Nordic Softdevice controller
CONFIG_BT_L2CAP_TX_MTU=247

# IMU settings
CONFIG_SENSOR=y
CONFIG_LSM6DSL_GYRO_FS=500
CONFIG_LSM6DSL_GYRO_ODR=4
CONFIG_LSM6DSL_ACCEL_ODR=4
CONFIG_LSM6DSL_ACCEL_FS=4
CONFIG_LSM6DSL_ENABLE_TEMP=y

# PM settings
CONFIG_PM_DEVICE=y
CONFIG_PM_DEVICE_RUNTIME=y
```

## boards/nrf52840dk_nrf52840.overlay
```dts
&timer2{
	status = "okay";
};
```

## boards/xiao_ble_sense.overlay
```dts
#include <zephyr/dt-bindings/gpio/nordic-nrf-gpio.h>
/ {
	model = "Seeed XIAO BLE Sense";
	compatible = "seeed,xiao-ble", "seeed,xiao-ble-sense";

	lsm6ds3tr-c-en {
		compatible = "regulator-fixed-sync", "regulator-fixed";
		enable-gpios = <&gpio1 8 (NRF_GPIO_DRIVE_S0H1 | GPIO_ACTIVE_HIGH)>;
		regulator-name = "LSM6DS3TR_C_EN";
		regulator-boot-on;
		startup-delay-us = <3000>;
	};
};
```

## src/main.c
```c
/*******************************************************************************
* Title                 :    
* Filename              :   main.c
* Author                :   ItachiVN
* Origin Date           :   2023/10/04
* Version               :   0.0.0
* Compiler              :   nRF connect SDK v2.4
* Target                :   nRF52840 SoC
* Notes                 :   None
*******************************************************************************/


/******************************************************************************
* Includes
*******************************************************************************/
#include <zephyr/kernel.h>

#include "ble\ble_gatt.h"
#include "ble\bluetoothle.h"
/******************************************************************************
* Module Preprocessor Constants
*******************************************************************************/
#define FW_MAJOR_VERSION                (0)
#define FW_MINOR_VERSION                (0)
#define FW_BUIILD_VERSION               (3)

#define SAMPLING_RATE_MS                (25)
#define SENSOR_PACKET_LEN               (24) // 4B for each axis * 6 axis
#define SENSOR_DATA_HEADER              (0xAA)

/******************************************************************************
* Module Preprocessor Macros
*******************************************************************************/
#include "zephyr/logging/log.h"
#define MODULE_NAME			        main
#define MODULE_LOG_LEVEL	        LOG_LEVEL_WRN
LOG_MODULE_REGISTER(MODULE_NAME, MODULE_LOG_LEVEL);

/******************************************************************************
* Module Typedefs
*******************************************************************************/

/******************************************************************************
* Module Variable Definitions
*******************************************************************************/
volatile static bool is_ble_connect=false;

void on_ble_connect(void)
{
    is_ble_connect = true;
    LOG_INF("BLE connected");
    if (ble_adv_stop() != 0)
    {
        LOG_ERR("BLE adv stop failed");
    }
}

void on_ble_disconnect(void)
{
    is_ble_connect = false;
    LOG_INF("BLE disconnected");
    if(ble_adv_start() != 0)
    {
        LOG_ERR("BLE adv start failed");
    }
}

int on_cmd_write_cb(void* p_data, void* p_len)
{
    // Dump receive data
    LOG_INF("Command received, recv %dB", *(int*)p_len);
    LOG_HEXDUMP_INF(p_data, *(int*)p_len, "raw_payload: ");
    return 0;
}

void* on_cmd_read_cb(void* p_data, void* p_len)
{
    static char default_char_value[]="CMD CHAR READ CB TRIGGER";
    *(int*)p_len = strlen(default_char_value);
    return default_char_value;
}


ble_callback_t ble_callback = 
{
    .ble_connected_cb = &on_ble_connect,
    .ble_disconnected_cb = &on_ble_disconnect,
};

ble_custom_gatt_cb_t ble_custom_gatt_cb = 
{
    .custom_char_read_cb = &on_cmd_read_cb,
    .custom_char_write_cb = &on_cmd_write_cb,
};
/******************************************************************************
* Function Prototypes
*******************************************************************************/
int ble_app_init(void);
/******************************************************************************
* Function Definitions
*******************************************************************************/

/*
 * @brief BLE application init
 * @param None
 * @retval 0: success, -1: failed
 */
int ble_app_init(void)
{
    if(ble_init(&ble_callback) != 0)
    {
        LOG_ERR("BLE init failed");
        return -1;
    }

    ble_custom_service_init(&ble_custom_gatt_cb);

    if (ble_adv_start() != 0)
    {
        LOG_ERR("BLE adv start failed");
        return -1;
    }
    return 0;
}


/*
 * @brief: Send sensor data via BLE
 * 
 * @param p_data: pointer to the data to send 
 * @param p_length: pointer to the length of the data to send
 * @param frame_cnt: frame count
 * @return int: 0 on success or negative code otherwise
 */
int sensor_data_send_ble(uint8_t* p_data, uint16_t* p_length, uint32_t frame_cnt)
{
    __ASSERT_NO_MSG(p_data != NULL);
    __ASSERT_NO_MSG(p_length != NULL);
    uint16_t input_len = *p_length;
#if (SENSOR_DATA_SEND_BOARDCAST != 0)
    uint8_t send_payload[1 + sizeof(frame_cnt) + input_len]; // 1B frame heaader + 4B frame count + 12B sensor data
    memset(send_payload, 0, sizeof(send_payload));
    send_payload[0] = SENSOR_DATA_HEADER;
    memcpy(send_payload + 1, &frame_cnt, sizeof(frame_cnt));
    memcpy(send_payload + 1 +sizeof(frame_cnt), p_data, input_len);
    return ble_set_custom_adv_payload(send_payload, 1 + sizeof(frame_cnt) + input_len);
#else /* !(SENSOR_DATA_SEND_BOARDCAST != 0) */
    uint8_t send_payload[sizeof(frame_cnt) + input_len]; //4B frame count + 12B sensor data
    memset(send_payload, 0, sizeof(send_payload));
    memcpy(send_payload, &frame_cnt, sizeof(frame_cnt));
    memcpy(send_payload +sizeof(frame_cnt), p_data, input_len);
    int send_status = sensor_char_send_indication(send_payload, sizeof(frame_cnt) + input_len);
    if(send_status != 0)
    {
        LOG_ERR("BLE send failed with status %d", send_status);
        return send_status;
    }
    return 0;
#endif /* End of (SENSOR_DATA_SEND_BOARDCAST != 0) */
    
}

int main(void)
{
    LOG_INF("Firmware version: %d.%d.%d", FW_MAJOR_VERSION, FW_MINOR_VERSION, FW_BUIILD_VERSION);
	if (ble_app_init() != 0)
    {
        LOG_ERR("App BLE init failed");
        return -1;
    }

#if (CONFIG_BOARD_XIAO_BLE == 1) 
    if (sensor_init() != 0)
    {
        LOG_ERR("IMU sensor init failed");
        return -1;
    }
#endif /* End of (CONFIG_BOARD_XIAO_BLE == 1)  */
    while(1)
    {
        if(is_ble_connect == false)
        {
            k_sleep(K_MSEC(1000));
            LOG_WRN("Waiting for BLE connection");
            continue;
        }
        static uint32_t frame_cnt = 0;
        frame_cnt++;
        uint8_t sensor_data[50] = {0};
        uint16_t sensor_data_len = 0;
#if (CONFIG_BOARD_XIAO_BLE == 1) 

        if (sensor_sampling(sensor_data, &sensor_data_len) != 0)
        {
            LOG_ERR("Sensor sampling failed");
        }
        if(sensor_data_len == SENSOR_PACKET_LEN)
        {
            if (sensor_data_send_ble(sensor_data, &sensor_data_len, frame_cnt) != 0)
            {
                LOG_ERR("Sensor data send BLE failed");
            }
            else
            {
                LOG_INF("Frame %d sent", frame_cnt);
                LOG_DBG("Accel (m/s^2): %.02f, %.02f, %.02f \r\n", *(float*)sensor_data, *(float*)(sensor_data + 4), *(float*)(sensor_data + 8));
                LOG_DBG("Gyro (radians/s): %.02f, %.02f, %.02f \r\n", *(float*)(sensor_data + 12), *(float*)(sensor_data + 16), *(float*)(sensor_data + 20));
            }
        }
        else
        {
            LOG_WRN("Sensor data length %d is invalid", sensor_data_len);
        }
#else // (CONFIG_BOARD_XIAO_BLE != 1) 
        // Simulate sending sensor data
        for(uint8_t count=0; count< SENSOR_PACKET_LEN; count++)
        {
            sensor_data[count] = count;
        }
        sensor_data_len = SENSOR_PACKET_LEN;
        if (sensor_data_send_ble(sensor_data, &sensor_data_len, frame_cnt) != 0)
        {
            LOG_ERR("Sensor data send BLE failed");
        }
        else
        {
            LOG_INF("Frame %d sent", frame_cnt);
        }
#endif /* End of (CONFIG_BOARD_XIAO_BLE == 1)  */
        k_sleep(K_MSEC(SAMPLING_RATE_MS));
    }
	return 0;
}
```

## src/imu_driver.c
```c
/*******************************************************************************
* Title                 :   Driver for LSM6DSL IMU
* Filename              :   imu_driver.c
* Origin Date           :   2023/10/09
* Version               :   0.0.0
* Compiler              :   nRF connect SDK v2.4
* Target                :   nRF52840 SoC
* Notes                 :   None
*******************************************************************************/


/** \file imu_driver.c
 *  \brief This module contains the
 */
/******************************************************************************
* Includes
*******************************************************************************/

/******************************************************************************
* Module Preprocessor Constants
*******************************************************************************/


/******************************************************************************
* Module Preprocessor Macros
*******************************************************************************/
#include "zephyr/logging/log.h"
#define MODULE_NAME			        imu_sensor
#define MODULE_LOG_LEVEL	        LOG_LEVEL_DBG
LOG_MODULE_REGISTER(MODULE_NAME, MODULE_LOG_LEVEL);

/******************************************************************************
* Module Typedefs
*******************************************************************************/

/******************************************************************************
* Module Variable Definitions
*******************************************************************************/

/******************************************************************************
* Function Prototypes
*******************************************************************************/

/******************************************************************************
* Function Definitions
*******************************************************************************/
#if (CONFIG_BOARD_XIAO_BLE == 1) 

#if (CONFIG_DT_HAS_ST_LSM6DSL_ENABLED != 0)
#include <zephyr/device.h>
#include <zephyr/drivers/sensor.h>
#else /* !(CONFIG_DT_HAS_ST_LSM6DSL_ENABLED != 0) */
#error "No enabled LSM6DSL sensor node"
#endif /* End of (CONFIG_DT_HAS_ST_LSM6DSL_ENABLED != 0) */

const struct device *const lsm6dsl_dev = DEVICE_DT_GET_ONE(st_lsm6dsl);
// Possible ODR of LSM6DSL

int sensor_init()
{
    if (!device_is_ready(lsm6dsl_dev)) 
    {
		LOG_ERR("LSM6DSL device not ready");
        return -1;
	}

    if (sensor_sample_fetch(lsm6dsl_dev) < 0) 
    {
        LOG_ERR("Cannot fetch sample");
        return -1;
	}
    return 0;
}

/*
 * @brief: Convert sensor data to float
 * 
 * @param val: input sensor data
 * @return float 
 */
float sensor_data_convert(struct sensor_value *val)
{
    __ASSERT_NO_MSG(val != NULL);
    return (float)(val->val1 + val->val2 / 1000000.0f);
}

/*
 * @brief: Sensor sampling
 * 
 * @param (out) p_data: pointer to store new data
 * @param (out) p_length: pointer to store length of new data
 * @return int: 0 on success or negative code otherwise
 */
int sensor_sampling(uint8_t* p_data, uint16_t* p_length)
{
    int status = 0;
    __ASSERT_NO_MSG(p_data != NULL);
    __ASSERT_NO_MSG(p_length != NULL);

    static struct sensor_value accel_x, accel_y, accel_z;
    static struct sensor_value gyro_x, gyro_y, gyro_z;

    static float accel_x_f, accel_y_f, accel_z_f;
    static float gyro_x_f, gyro_y_f, gyro_z_f;
    
    if (sensor_sample_fetch_chan(lsm6dsl_dev, SENSOR_CHAN_ACCEL_XYZ) < 0) {
        LOG_ERR("Cannot fetch accel sample");
        return -1;
    }
    if (sensor_channel_get(lsm6dsl_dev, SENSOR_CHAN_ACCEL_X, &accel_x) < 0) {
        LOG_ERR("Cannot get accel_x data");
        return -1;
    }
    if (sensor_channel_get(lsm6dsl_dev, SENSOR_CHAN_ACCEL_Y, &accel_y) < 0) {
        LOG_ERR("Cannot get accel_y data");
        return -1;
    }
    if (sensor_channel_get(lsm6dsl_dev, SENSOR_CHAN_ACCEL_Z, &accel_z) < 0) {
        LOG_ERR("Cannot get accel_z data");
        return -1;
    }

    /* lsm6dsl gyro */
    if (sensor_sample_fetch_chan(lsm6dsl_dev, SENSOR_CHAN_GYRO_XYZ) < 0) {
        LOG_ERR("Cannot fetch gyro sample");
        return -1;
    }
    if (sensor_channel_get(lsm6dsl_dev, SENSOR_CHAN_GYRO_X, &gyro_x) < 0) {
        LOG_ERR("Cannot get gyro_x data");
        return -1;
    }
    if (sensor_channel_get(lsm6dsl_dev, SENSOR_CHAN_GYRO_Y, &gyro_y) < 0) {
        LOG_ERR("Cannot get gyro_y data");
        return -1;
    }
    if (sensor_channel_get(lsm6dsl_dev, SENSOR_CHAN_GYRO_Z, &gyro_z) < 0) {
        LOG_ERR("Cannot get gyro_z data");
        return -1;
    }

    accel_x_f = sensor_data_convert(&accel_x);
    accel_y_f = sensor_data_convert(&accel_y);
    accel_z_f = sensor_data_convert(&accel_z);

    gyro_x_f = sensor_data_convert(&gyro_x);
    gyro_y_f = sensor_data_convert(&gyro_y);
    gyro_z_f = sensor_data_convert(&gyro_z);

    uint16_t payload_idx = 0;
    memcpy(p_data + payload_idx, &accel_x_f, sizeof(accel_x_f));
    payload_idx += sizeof(accel_x_f);
    memcpy(p_data + payload_idx, &accel_y_f, sizeof(accel_y_f));
    payload_idx += sizeof(accel_y_f);
    memcpy(p_data + payload_idx, &accel_z_f, sizeof(accel_z_f));
    payload_idx += sizeof(accel_z_f);

    memcpy(p_data + payload_idx, &gyro_x_f, sizeof(gyro_x_f));
    payload_idx += sizeof(gyro_x_f);
    memcpy(p_data + payload_idx, &gyro_y_f, sizeof(gyro_y_f));
    payload_idx += sizeof(gyro_y_f);
    memcpy(p_data + payload_idx, &gyro_z_f, sizeof(gyro_z_f));
    payload_idx += sizeof(gyro_z_f);

    *p_length = payload_idx;
    return status;
}
#endif /* End of (CONFIG_BOARD_XIAO_BLE == 1)  */
```

## src/imu_driver.h
```c
/****************************************************************************
* Title                 :   Driver for LSM6DSL IMU header file
* Filename              :   imu_driver.h
* Origin Date           :   2023/10/09
* Version               :   v0.0.0
* Compiler              :   nRF connect SDK v2.4
* Target                :   nRF52840 SoC
* Notes                 :   None
*****************************************************************************/


/** \file imu_driver.h
 *  \brief This module contains .
 *
 *  This is the header file for 
 */
#ifndef IMU_DRIVER_H_
#define IMU_DRIVER_H_

/******************************************************************************
* Includes
*******************************************************************************/


/******************************************************************************
* Preprocessor Constants
*******************************************************************************/


/******************************************************************************
* Configuration Constants
*******************************************************************************/


/******************************************************************************
* Macros
*******************************************************************************/


/******************************************************************************
* Typedefs
*******************************************************************************/


/******************************************************************************
* Variables
*******************************************************************************/


/******************************************************************************
* Function Prototypes
*******************************************************************************/

#ifdef __cplusplus
extern "C"{
#endif
int sensor_init();
int sensor_sampling(uint8_t* p_data, uint16_t* p_length);
float sensor_data_convert(struct sensor_value *val);
void Function(void);

#ifdef __cplusplus
} // extern "C"
#endif

#endif // IMU_DRIVER_H_

/*** End of File **************************************************************/
```
